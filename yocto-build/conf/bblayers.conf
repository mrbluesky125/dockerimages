## yocto-build/conf/bblayers.conf
```bitbake
# POKY_BBLAYERS_CONF_VERSION is increased each time build/conf/bblayers.conf
# changes incompatibly
POKY_BBLAYERS_CONF_VERSION = "2"

BBPATH = "${TOPDIR}"
BBFILES ?= ""

BBLAYERS ?= " \
  /home/bitbake/yocto/meta \
  /home/bitbake/yocto/meta-poky \
  /home/bitbake/yocto/meta-custom/meta-openembedded/meta-oe \
  /home/bitbake/yocto/meta-custom/meta-openembedded/meta-networking \
  /home/bitbake/yocto/meta-custom/meta-openembedded/meta-python \
  /home/bitbake/yocto/meta-custom/meta-qt5 \
  /home/bitbake/yocto/meta-custom/meta-tegra \
  /home/bitbake/yocto/meta-custom/meta-tegra/contrib \
  /home/bitbake/yocto/meta-custom/meta-tegradevboard \
  "
```
